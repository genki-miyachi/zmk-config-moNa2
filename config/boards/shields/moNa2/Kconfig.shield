## config/boards/shields/moNa2/Kconfig.shield
```kconfig
if SHIELD_MONA2_R

config SHIELD_MONA2_R
    def_bool $(shields_list_contains,moNa2_R)

endif

if SHIELD_MONA2_L

config SHIELD_MONA2_L
    def_bool $(shields_list_contains,moNa2_L)

endif
```
